## main/Kconfig.projbuild
```kconfig
menu "iot-sad-zvuk"

    config IOT_WIFI_SSID
        string "Wi-Fi SSID"
        default ""

    config IOT_WIFI_PASSWORD
        string "Wi-Fi пароль"
        default ""

    config IOT_MQTT_URI
        string "MQTT broker URI (пусто = MQTT выключен)"
        default "mqtt://5.183.191.188:31883"

    config IOT_MQTT_USERNAME
        string "MQTT логин"
        default "device"

    config IOT_MQTT_PASSWORD
        string "MQTT пароль"
        default ""

    config ZVUK_OTA_REPO
        string "GitHub-репозиторий для OTA (owner/repo, пусто = OTA выключен)"
        default "thefrol/iot-sad-zvuk"

    config ZVUK_OTA_CHECK_INTERVAL_MIN
        int "Интервал проверки обновлений, минут"
        default 60
        range 1 1440

endmenu
```

## sdkconfig.defaults
```kconfig
CONFIG_IDF_TARGET="esp32c3"
CONFIG_ESPTOOLPY_FLASHSIZE_4MB=y
CONFIG_ESPTOOLPY_FLASHSIZE="4MB"
CONFIG_PARTITION_TABLE_CUSTOM=y
CONFIG_PARTITION_TABLE_CUSTOM_FILENAME="partitions.csv"
CONFIG_PARTITION_TABLE_FILENAME="partitions.csv"
CONFIG_COMPILER_OPTIMIZATION_PERF=y
# OTA: новая прошивка обязана подтвердить себя, иначе загрузчик откатит слот
CONFIG_BOOTLOADER_APP_ROLLBACK_ENABLE=y
# esp_audio_codec по умолчанию линкует ВСЕ декодеры/энкодеры (LC3, AMR, Opus,
# SBC, ALAC...) — это сотни килобайт. Играем только MP3, остальное выключено.
CONFIG_AUDIO_DECODER_AAC_SUPPORT=n
CONFIG_AUDIO_DECODER_G711_SUPPORT=n
CONFIG_AUDIO_DECODER_AMRNB_SUPPORT=n
CONFIG_AUDIO_DECODER_AMRWB_SUPPORT=n
CONFIG_AUDIO_DECODER_FLAC_SUPPORT=n
CONFIG_AUDIO_DECODER_OPUS_SUPPORT=n
CONFIG_AUDIO_DECODER_VORBIS_SUPPORT=n
CONFIG_AUDIO_DECODER_ADPCM_SUPPORT=n
CONFIG_AUDIO_DECODER_ALAC_SUPPORT=n
CONFIG_AUDIO_DECODER_PCM_SUPPORT=n
CONFIG_AUDIO_DECODER_SBC_SUPPORT=n
CONFIG_AUDIO_DECODER_LC3_SUPPORT=n
CONFIG_AUDIO_DECODER_G722_SUPPORT=n
CONFIG_AUDIO_SIMPLE_DEC_WAV_SUPPORT=n
CONFIG_AUDIO_SIMPLE_DEC_M4A_SUPPORT=n
CONFIG_AUDIO_SIMPLE_DEC_TS_SUPPORT=n
CONFIG_AUDIO_SIMPLE_DEC_OGG_SUPPORT=n
CONFIG_AUDIO_ENCODER_AAC_SUPPORT=n
CONFIG_AUDIO_ENCODER_G711_SUPPORT=n
CONFIG_AUDIO_ENCODER_AMRNB_SUPPORT=n
CONFIG_AUDIO_ENCODER_AMRWB_SUPPORT=n
CONFIG_AUDIO_ENCODER_OPUS_SUPPORT=n
CONFIG_AUDIO_ENCODER_ADPCM_SUPPORT=n
CONFIG_AUDIO_ENCODER_ALAC_SUPPORT=n
CONFIG_AUDIO_ENCODER_PCM_SUPPORT=n
CONFIG_AUDIO_ENCODER_SBC_SUPPORT=n
CONFIG_AUDIO_ENCODER_LC3_SUPPORT=n
CONFIG_AUDIO_ENCODER_G722_SUPPORT=n
```
